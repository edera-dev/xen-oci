## configs/4.22/amd64.defconfig
```kconfig
# CONFIG_PV32 is not set
CONFIG_HVM=y
CONFIG_MEM_SHARING=y
CONFIG_SHADOW_PAGING=y
CONFIG_XEN_GUEST=y
CONFIG_HYPERV_GUEST=y
CONFIG_KVM_GUEST=y
# CONFIG_LIVEPATCH is not set
CONFIG_ENFORCE_UNIQUE_SYMBOLS=y
CONFIG_UNSUPPORTED=y
```
